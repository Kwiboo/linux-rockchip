// SPDX-License-Identifier: (GPL-2.0+ OR MIT)

/dts-v1/;
#include "rk3506-luckfox-lyra.dtsi"

/ {
	model = "Luckfox Lyra Plus";
	compatible = "luckfox,lyra-plus", "luckfox,lyra", "rockchip,rk3506";
};
