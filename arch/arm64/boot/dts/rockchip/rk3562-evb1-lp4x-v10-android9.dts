// SPDX-License-Identifier: (GPL-2.0+ OR MIT)
/*
 * Copyright (c) 2022 Rockchip Electronics Co., Ltd.
 *
 */

#include "rk3562-evb1-lp4x-v10.dtsi"
#include "rk3562-android9.dtsi"
#include "rk3562-rk817.dtsi"

/ {
	model = "Rockchip RK3562 EVB1 LP4X V10 Board";
	compatible = "rockchip,rk3562-evb1-lp4x-v10", "rockchip,rk3562", "rockchip,Android9";
};
