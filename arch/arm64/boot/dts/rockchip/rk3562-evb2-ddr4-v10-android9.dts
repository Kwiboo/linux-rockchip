// SPDX-License-Identifier: (GPL-2.0+ OR MIT)
/*
 * Copyright (c) 2022 Rockchip Electronics Co., Ltd.
 *
 */

#include "rk3562-evb2-ddr4-v10.dtsi"
#include "rk3562-android9.dtsi"
#include "rk3562-rk809.dtsi"
#include "rk3562-evb2-cam.dtsi"

/ {
	model = "Rockchip RK3562 EVB2 DDR4 V10 Board";
	compatible = "rockchip,rk3562-evb2-ddr4-v10", "rockchip,rk3562", "rockchip,Android9";
};
