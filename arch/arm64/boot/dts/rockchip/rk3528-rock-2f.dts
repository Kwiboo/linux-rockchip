// SPDX-License-Identifier: (GPL-2.0+ OR MIT)

/dts-v1/;

#include "rk3528-rock-2.dtsi"

/ {
	model = "Radxa ROCK 2F";
	compatible = "radxa,rock-2f", "rockchip,rk3528";
};

&combphy {
	status = "okay";
};

&pcie {
	pinctrl-names = "default";
	pinctrl-0 = <&pciem1_pins>;
	reset-gpios = <&gpio1 RK_PA2 GPIO_ACTIVE_HIGH>;
	vpcie3v3-supply = <&vcc_3v3>;
	status = "okay";
};
