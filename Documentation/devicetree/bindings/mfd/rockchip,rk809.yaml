## Documentation/devicetree/bindings/mfd/rockchip,rk809.yaml
```yaml
# SPDX-License-Identifier: GPL-2.0-only OR BSD-2-Clause
%YAML 1.2
---
$id: http://devicetree.org/schemas/mfd/rockchip,rk809.yaml#
$schema: http://devicetree.org/meta-schemas/core.yaml#

title: RK809 Power Management Integrated Circuit

maintainers:
  - Chris Zhong <zyw@rock-chips.com>
  - Zhang Qing <zhangqing@rock-chips.com>

description: |
  Rockchip RK809 series PMIC. This device consists of an i2c controlled MFD
  that includes regulators, an RTC, and power button.

properties:
  compatible:
    enum:
      - rockchip,rk809

  reg:
    maxItems: 1

  interrupts:
    maxItems: 1

  '#clock-cells':
    description: |
      See <dt-bindings/clock/rockchip,rk808.h> for clock IDs.
    minimum: 0
    maximum: 1

  clock-output-names:
    description:
      From common clock binding to override the default output clock name.

  rockchip,system-power-controller:
    type: boolean
    deprecated: true
    description:
      Telling whether or not this PMIC is controlling the system power.

  system-power-controller: true

  wakeup-source:
    type: boolean
    description:
      Device can be used as a wakeup source.

  vcc1-supply:
    description:
      The input supply for DCDC_REG1.

  vcc2-supply:
    description:
      The input supply for DCDC_REG2.

  vcc3-supply:
    description:
      The input supply for DCDC_REG3.

  vcc4-supply:
    description:
      The input supply for DCDC_REG4.

  vcc5-supply:
    description:
      The input supply for LDO_REG1, LDO_REG2, and LDO_REG3.

  vcc6-supply:
    description:
      The input supply for LDO_REG4, LDO_REG5, and LDO_REG6.

  vcc7-supply:
    description:
      The input supply for LDO_REG7, LDO_REG8, and LDO_REG9.

  vcc8-supply:
    description:
      The input supply for SWITCH_REG2.

  vcc9-supply:
    description:
      The input supply for DCDC_REG5 and SWITCH_REG1.

  regulators:
    type: object
    patternProperties:
      "^(LDO_REG[1-9]|DCDC_REG[1-5]|SWITCH_REG[1-2])$":
        type: object
        $ref: /schemas/regulator/regulator.yaml#
        unevaluatedProperties: false
    unevaluatedProperties: false

allOf:
  - if:
      properties:
        '#clock-cells':
          const: 0

    then:
      properties:
        clock-output-names:
          maxItems: 1

    else:
      properties:
        clock-output-names:
          maxItems: 2

required:
  - compatible
  - reg
  - interrupts
  - "#clock-cells"

additionalProperties: false

examples:
  - |
    #include <dt-bindings/pinctrl/rockchip.h>
    #include <dt-bindings/interrupt-controller/irq.h>
    #include <dt-bindings/gpio/gpio.h>
    i2c {
        #address-cells = <1>;
        #size-cells = <0>;

        rk809: pmic@20 {
            compatible = "rockchip,rk809";
            reg = <0x20>;
            #clock-cells = <1>;
            clock-output-names = "rk809-clkout1", "rk809-clkout2";
            interrupt-parent = <&gpio0>;
            interrupts = <RK_PA3 IRQ_TYPE_LEVEL_LOW>;
            pinctrl-names = "default";
            pinctrl-0 = <&pmic_int_l>;
            system-power-controller;
            wakeup-source;

            vcc1-supply = <&vcc3v3_sys>;
            vcc2-supply = <&vcc3v3_sys>;
            vcc3-supply = <&vcc3v3_sys>;
            vcc4-supply = <&vcc3v3_sys>;
            vcc5-supply = <&vcc3v3_sys>;
            vcc6-supply = <&vcc3v3_sys>;
            vcc7-supply = <&vcc3v3_sys>;
            vcc8-supply = <&vcc3v3_sys>;
            vcc9-supply = <&vcc3v3_sys>;

            regulators {
                vdd_logic: DCDC_REG1 {
                    regulator-name = "vdd_logic";
                    regulator-always-on;
                    regulator-boot-on;
                    regulator-initial-mode = <0x2>;
                    regulator-min-microvolt = <500000>;
                    regulator-max-microvolt = <1350000>;
                    regulator-ramp-delay = <6001>;

                    regulator-state-mem {
                        regulator-off-in-suspend;
                    };
                };

                vdd_gpu: DCDC_REG2 {
                    regulator-name = "vdd_gpu";
                    regulator-always-on;
                    regulator-boot-on;
                    regulator-initial-mode = <0x2>;
                    regulator-min-microvolt = <500000>;
                    regulator-max-microvolt = <1350000>;
                    regulator-ramp-delay = <6001>;

                    regulator-state-mem {
                        regulator-off-in-suspend;
                    };
                };

                vcc_ddr: DCDC_REG3 {
                    regulator-name = "vcc_ddr";
                    regulator-always-on;
                    regulator-boot-on;
                    regulator-initial-mode = <0x2>;

                    regulator-state-mem {
                        regulator-on-in-suspend;
                    };
                };

                vdd_npu: DCDC_REG4 {
                    regulator-name = "vdd_npu";
                    regulator-initial-mode = <0x2>;
                    regulator-min-microvolt = <500000>;
                    regulator-max-microvolt = <1350000>;
                    regulator-ramp-delay = <6001>;

                    regulator-state-mem {
                        regulator-off-in-suspend;
                    };
                };

                vcc_1v8: DCDC_REG5 {
                    regulator-name = "vcc_1v8";
                    regulator-always-on;
                    regulator-boot-on;
                    regulator-min-microvolt = <1800000>;
                    regulator-max-microvolt = <1800000>;

                    regulator-state-mem {
                        regulator-off-in-suspend;
                    };
                };

                vdda0v9_image: LDO_REG1 {
                    regulator-name = "vdda0v9_image";
                    regulator-min-microvolt = <900000>;
                    regulator-max-microvolt = <900000>;

                    regulator-state-mem {
                        regulator-off-in-suspend;
                    };
                };

                vdda_0v9: LDO_REG2 {
                    regulator-name = "vdda_0v9";
                    regulator-always-on;
                    regulator-boot-on;
                    regulator-min-microvolt = <900000>;
                    regulator-max-microvolt = <900000>;

                    regulator-state-mem {
                        regulator-off-in-suspend;
                    };
                };

                vdda0v9_pmu: LDO_REG3 {
                    regulator-name = "vdda0v9_pmu";
                    regulator-always-on;
                    regulator-boot-on;
                    regulator-min-microvolt = <900000>;
                    regulator-max-microvolt = <900000>;

                    regulator-state-mem {
                        regulator-on-in-suspend;
                        regulator-suspend-microvolt = <900000>;
                    };
                };

                vccio_acodec: LDO_REG4 {
                    regulator-name = "vccio_acodec";
                    regulator-always-on;
                    regulator-boot-on;
                    regulator-min-microvolt = <3300000>;
                    regulator-max-microvolt = <3300000>;

                    regulator-state-mem {
                        regulator-off-in-suspend;
                    };
                };

                vccio_sd: LDO_REG5 {
                    regulator-name = "vccio_sd";
                    regulator-always-on;
                    regulator-boot-on;
                    regulator-min-microvolt = <1800000>;
                    regulator-max-microvolt = <3300000>;

                    regulator-state-mem {
                        regulator-off-in-suspend;
                    };
                };

                vcc3v3_pmu: LDO_REG6 {
                    regulator-name = "vcc3v3_pmu";
                    regulator-always-on;
                    regulator-boot-on;
                    regulator-min-microvolt = <3300000>;
                    regulator-max-microvolt = <3300000>;

                    regulator-state-mem {
                        regulator-on-in-suspend;
                        regulator-suspend-microvolt = <3300000>;
                    };
                };

                vcca_1v8: LDO_REG7 {
                    regulator-name = "vcca_1v8";
                    regulator-always-on;
                    regulator-boot-on;
                    regulator-min-microvolt = <1800000>;
                    regulator-max-microvolt = <1800000>;

                    regulator-state-mem {
                        regulator-off-in-suspend;
                    };
                };

                vcca1v8_pmu: LDO_REG8 {
                    regulator-name = "vcca1v8_pmu";
                    regulator-always-on;
                    regulator-boot-on;
                    regulator-min-microvolt = <1800000>;
                    regulator-max-microvolt = <1800000>;

                    regulator-state-mem {
                        regulator-on-in-suspend;
                        regulator-suspend-microvolt = <1800000>;
                    };
                };

                vcca1v8_image: LDO_REG9 {
                    regulator-name = "vcca1v8_image";
                    regulator-min-microvolt = <1800000>;
                    regulator-max-microvolt = <1800000>;

                    regulator-state-mem {
                        regulator-off-in-suspend;
                    };
                };

                vcc_3v3: SWITCH_REG1 {
                    regulator-name = "vcc_3v3";
                    regulator-always-on;
                    regulator-boot-on;

                    regulator-state-mem {
                        regulator-off-in-suspend;
                    };
                };

                vcc3v3_sd: SWITCH_REG2 {
                    regulator-name = "vcc3v3_sd";
                    regulator-always-on;
                    regulator-boot-on;

                    regulator-state-mem {
                        regulator-off-in-suspend;
                    };
                };
            };
        };
    };
```
