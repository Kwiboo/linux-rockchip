## Documentation/devicetree/bindings/clock/rockchip,rk3506-cru.yaml
```yaml
# SPDX-License-Identifier: (GPL-2.0-only OR BSD-2-Clause)
%YAML 1.2
---
$id: http://devicetree.org/schemas/clock/rockchip,rk3506-cru.yaml#
$schema: http://devicetree.org/meta-schemas/core.yaml#

title: Rockchip RK3506 Clock and Reset Controller

maintainers:
  - Yao Zi <ziyao@disroot.org>

description: |
  The RK3506 clock controller generates the clock and also implements a reset
  controller for SoC peripherals. For example, it provides SCLK_UART0 and
  PCLK_UART0 as well as SRST_P_UART0 and SRST_S_UART0 for the first UART
  module.
  Each clock is assigned an identifier, consumer nodes can use it to specify
  the clock. All available clock and reset IDs are defined in dt-binding
  headers.

properties:
  compatible:
    const: rockchip,rk3506-cru

  reg:
    maxItems: 1

  clocks:
    items:
      - description: External 24MHz oscillator clock

  clock-names:
    items:
      - const: xin24m

  "#clock-cells":
    const: 1

  "#reset-cells":
    const: 1

required:
  - compatible
  - reg
  - clocks
  - clock-names
  - "#clock-cells"
  - "#reset-cells"

additionalProperties: false

examples:
  - |
    clock-controller@ff9a0000 {
        compatible = "rockchip,rk3506-cru";
        reg = <0xff9a0000 0x20000>;
        clocks = <&xin24m>;
        clock-names = "xin24m";
        #clock-cells = <1>;
        #reset-cells = <1>;
    };
```

## Documentation/devicetree/bindings/remoteproc/rockchip,rk3588-rproc.yaml
```yaml
# SPDX-License-Identifier: (GPL-2.0 OR BSD-2-Clause)
%YAML 1.2
---
$id: http://devicetree.org/schemas/remoteproc/rockchip,rk3588-rproc.yaml#
$schema: http://devicetree.org/meta-schemas/core.yaml#

title: Rockchip RK3588 Remote Processor Controller

description: |
  This document defines the binding for the Rockchip remoteproc driver that
  loads and boots firmware on RK3588 remote processors. Two remote core types
  are supported:
    - AP core (Cortex-A55) in AMP mode, compatible "rockchip,rk3588-rproc-ap"
    - MCU core (PMU Cortex-M0), compatible "rockchip,rk3588-rproc-mcu"

maintainers:
  - Jing Wu <jing.wu@rock-chips.com>

properties:
  compatible:
    enum:
      - rockchip,rk3588-rproc-ap
      - rockchip,rk3588-rproc-mcu

  memory-region:
    $ref: /schemas/types.yaml#/definitions/phandle-array
    description: |
      Phandle(s) to reserved memory regions for remote processor firmware.
      AP scenario typically uses multi-carveout: firmware + share + rpmsg.
      MCU scenario uses single carveout.
      The primary region must cover all ELF LOAD segments.

  resets:
    maxItems: 1
    description:
      Reset specifier for the PMU M0 (Cortex-M0) core. Required for
      "rockchip,rk3588-rproc-mcu".

  rockchip,grf:
    $ref: /schemas/types.yaml#/definitions/phandle
    description:
      Phandle to the GRF (General Register File) syscon node.
      Optional for both AP and MCU scenarios.

  rockchip,cpu-id:
    $ref: /schemas/types.yaml#/definitions/uint32
    description:
      MPIDR of the remote AP core (e.g., 0x300 for A55 cluster0 core3).
      Only used for "rockchip,rk3588-rproc-ap".

  rockchip,pe-state:
    $ref: /schemas/types.yaml#/definitions/uint32
    description: |
      PE (Processing Element) state passed to ATF via SMC to configure
      the remote CPU mode before boot. Encoding:
        bit 1: RK_AMP_FLAG_CPU_ARM64 (1=AArch64, 0=AArch32)
        bit 2: RK_AMP_FLAG_CPU_EL2_HYP (1=EL2, 0=EL1)
        bit 3: RK_AMP_FLAG_CPU_ARM32_T (1=Thumb, 0=ARM)
      Typical value for AArch64 EL2: 6 (BIT(1) | BIT(2)).
      Only used for "rockchip,rk3588-rproc-ap".

required:
  - compatible
  - memory-region

allOf:
  - if:
      properties:
        compatible:
          const: rockchip,rk3588-rproc-mcu
    then:
      required:
        - resets

additionalProperties: false

examples:
  - |
    /* AP (Cortex-A55) scenario */
    rproc_ap: remoteproc-ap {
        compatible = "rockchip,rk3588-rproc-ap";
        memory-region = <&firmware_reserved>, <&amp_shmem_reserved>, <&rpmsg_reserved>;
        rockchip,cpu-id = <0x300>;
        rockchip,pe-state = <6>;  /* RK_AMP_FLAG_CPU_ARM64 | RK_AMP_FLAG_CPU_EL2_HYP */
    };

  - |
    #include <dt-bindings/clock/rk3588-cru.h>

    /* MCU (PMU Cortex-M0) scenario */
    rproc_mcu: remoteproc-mcu {
        compatible = "rockchip,rk3588-rproc-mcu";
        memory-region = <&firmware_reserved>;
        resets = <&cru SRST_F_PMU_CM0_CORE>;
        rockchip,grf = <&sys_grf>;
    };
...
```

## drivers/iio/imu/rk_amp_imu/Kconfig
```kconfig
# SPDX-License-Identifier: GPL-2.0-or-later

config ROCKCHIP_AMP_IMU
	tristate "Rockchip AMP IMU driver"
	depends on ROCKCHIP_AMP_RPMSG_SHAREDMEM
	select IIO_BUFFER
	help
	  This driver supports the Rockchip AMP IMU driver
```
