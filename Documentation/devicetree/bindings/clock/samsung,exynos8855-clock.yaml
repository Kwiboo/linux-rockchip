## Documentation/devicetree/bindings/clock/samsung,exynos8855-clock.yaml
```yaml
# SPDX-License-Identifier: (GPL-2.0-only OR BSD-2-Clause)
%YAML 1.2
---
$id: http://devicetree.org/schemas/clock/samsung,exynos8855-clock.yaml#
$schema: http://devicetree.org/meta-schemas/core.yaml#

title: Samsung Exynos 8855 SoC clock controller

maintainers:
  - Raghav Sharma <raghav.s@samsung.com>

description: |
  Exynos 8855 clock controller is comprised of several CMU units, generating
  clocks for different domains. Those CMU units are modeled as separate device
  tree nodes, and might depend on each other. Root clocks in that clock tree are
  two external clocks:: OSCCLK/XTCXO (76.8 MHz) and RTCCLK/XrtcXTI (32768 Hz).
  The external OSCCLK must be defined as fixed-rate clock in dts.

  CMU_TOP is a top-level CMU, where all base clocks are prepared using PLLs and
  dividers; all other clocks of function blocks (other CMUs) are usually
  derived from CMU_TOP.

  Each clock is assigned an identifier and client nodes can use this identifier
  to specify the clock which they consume. All clocks available for usage
  in clock consumer nodes are defined as preprocessor macros in
  'include/dt-bindings/clock/samsung,exynos8855.h' header.

properties:
  compatible:
    enum:
      - samsung,exynos8855-cmu-peric
      - samsung,exynos8855-cmu-peris
      - samsung,exynos8855-cmu-top

  clocks:
    minItems: 1
    maxItems: 4

  clock-names:
    minItems: 1
    maxItems: 4

  "#clock-cells":
    const: 1

  reg:
    maxItems: 1

  samsung,sysreg:
    $ref: /schemas/types.yaml#/definitions/phandle
    description:
      Phandle to system registers interface.

allOf:
  - if:
      properties:
        compatible:
          contains:
            const: samsung,exynos8855-cmu-peric

    then:
      properties:
        clocks:
          items:
            - description: External reference clock (76.8 MHz)
            - description: CMU_PERIC NOC clock (from CMU_TOP)
            - description: CMU_PERIC MMC_CARD clock (from CMU_TOP)
            - description: CMU_PERIC IP clock (from CMU_TOP)

        clock-names:
          items:
            - const: oscclk
            - const: bus
            - const: mmc_card
            - const: ip

  - if:
      properties:
        compatible:
          contains:
            const: samsung,exynos8855-cmu-peris

    then:
      properties:
        clocks:
          items:
            - description: External reference clock (76.8 MHz)
            - description: CMU_PERIS GIC clock (from CMU_TOP)
            - description: CMU_PERIS NOC clock (from CMU_TOP)

        clock-names:
          items:
            - const: oscclk
            - const: gic
            - const: bus

  - if:
      properties:
        compatible:
          contains:
            const: samsung,exynos8855-cmu-top

    then:
      properties:
        clocks:
          items:
            - description: External reference clock (76.8 MHz)

        clock-names:
          items:
            - const: oscclk

  - if:
      properties:
        compatible:
          contains:
            const: samsung,exynos8855-cmu-top
    then:
      properties:
        samsung,sysreg: false
    else:
      required:
        - samsung,sysreg

required:
  - compatible
  - "#clock-cells"
  - clocks
  - clock-names
  - reg

additionalProperties: false

examples:
  - |
    #include <dt-bindings/clock/samsung,exynos8855.h>

    cmu_peric0: clock-controller@15400000 {
        compatible = "samsung,exynos8855-cmu-peric";
        reg = <0x15400000 0x8000>;
        #clock-cells = <1>;

        clocks = <&xtcxo>,
                 <&cmu_top CLKCMU_DOUT_PERIC_NOC>,
                 <&cmu_top CLKCMU_DOUT_PERIC_MMC_CARD>,
                 <&cmu_top CLKCMU_DOUT_PERIC_IP>;
        clock-names = "oscclk",
                      "bus",
                      "mmc_card",
                      "ip";
        samsung,sysreg = <&sysreg_peric>;
    };

...
```
